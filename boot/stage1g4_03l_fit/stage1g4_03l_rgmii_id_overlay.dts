/dts-v1/;
/plugin/;

/*
 * 03l changes only the Linux PHY interface mode. The 03k DT already
 * contains PHY@2, delay code 7/7, aliases, and the converter removal.
 */


/ {
	fragment@0 {
		target-path = "/axi/ethernet@ff0d0000";

		__overlay__ {
			phy-mode = "rgmii-id";
		};
	};
};
