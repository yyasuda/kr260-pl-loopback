## boot/stage1g4_03k_bootfw/meta-stage1g4/conf/layer.conf
```bitbake
BBPATH .= ":${LAYERDIR}"

BBFILES += "${LAYERDIR}/recipes-*/*/*.bb ${LAYERDIR}/recipes-*/*/*.bbappend"

BBFILE_COLLECTIONS += "stage1g4"
BBFILE_PATTERN_stage1g4 = "^${LAYERDIR}/"
BBFILE_PRIORITY_stage1g4 = "8"

LAYERSERIES_COMPAT_stage1g4 = "scarthgap"
LAYERDEPENDS_stage1g4 = "core xilinx-standalone-sdt"
```
